OUTPUT_FORMAT("pe-i386")
OUTPUT_ARCH(i386)
ENTRY(_start)

SECTIONS
{
    /* Адрес загрузки пользовательских программ - см. USER_PROGRAM_BASE
       в kernel.c. Эта область уже identity-mapped и помечена PRESENT|
       USER|RW в paging.c (init_paging покрывает первые 4 МБ), так что
       никаких изменений в paging для запуска ring3-кода здесь не нужно. */
    . = 0x100000;
    .text : { *(.text) }
    /* ВАЖНО: граница код/данные (см. PT_AXOS_WX, elf.c/paging.c) обязана
       совпадать со страницей - PAE не умеет разные права доступа внутри
       одной 4КБ-страницы, так что без этого ALIGN() либо код, либо
       данные в "пограничной" странице получают неверные права (найдено
       вживую дважды на httpsrv.bin - см. память project_tcp_mux_send_retransmit).
       Раньше эту выровненность обеспечивал ТОЛЬКО ASLR-delta в elf.c (см.
       комментарий там про align_fix) - при нехватке места под delta
       выравнивания не было вообще. Явный ALIGN здесь делает его
       гарантированным независимо от ASLR/бюджета слота. */
    . = ALIGN(0x1000);
    .data : { *(.data) }
    .bss : { *(.bss) }
}
